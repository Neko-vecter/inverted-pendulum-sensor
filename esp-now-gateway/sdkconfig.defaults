## esp-now-gateway/src/Kconfig.projbuild
```kconfig
menu "ESP-NOW gateway"

config GATEWAY_ESPNOW_CHANNEL
    int "ESP-NOW radio channel"
    range 1 11
    default 1

choice GATEWAY_SERIAL_INTERFACE
    prompt "Host serial interface"
    default GATEWAY_SERIAL_USB

config GATEWAY_SERIAL_USB
    bool "Native USB Serial/JTAG (XIAO ESP32-C6 USB port)"

config GATEWAY_SERIAL_UART
    bool "UART1 (external USB-UART adapter)"

endchoice

if GATEWAY_SERIAL_UART
config GATEWAY_UART_TX_GPIO
    int "UART1 TX GPIO"
    range 0 30
    default 16

config GATEWAY_UART_RX_GPIO
    int "UART1 RX GPIO"
    range 0 30
    default 17

config GATEWAY_UART_BAUD
    int "UART1 baud rate"
    range 115200 3000000
    default 921600
endif

endmenu
```

## firmware/esp32c6/src/Kconfig.projbuild
```kconfig
menu "Pendulum sensor"

config SENSOR_WIFI_SSID
    string "Wi-Fi SSID"
    default ""
    help
        Wi-Fi network used by the sensor node. Leave empty to run sampling
        without starting the network.

config SENSOR_WIFI_PASSWORD
    string "Wi-Fi password"
    default ""
    help
        WPA2 passphrase for the configured network (8-63 bytes), or a 64-digit
        hexadecimal pre-shared key. An empty password selects an open network.

config SENSOR_SERVER_IPV4
    string "UDP server IPv4 address"
    default "192.168.1.100"

config SENSOR_SERVER_PORT
    int "UDP server port"
    range 1 65535
    default 5000

config SENSOR_I2C_SDA_GPIO
    int "MT6701 I2C SDA GPIO"
    range 0 30
    default 22

config SENSOR_I2C_SCL_GPIO
    int "MT6701 I2C SCL GPIO"
    range 0 30
    default 23

config SENSOR_I2C_CLOCK_HZ
    int "MT6701 I2C clock (Hz)"
    range 100000 400000
    default 400000

endmenu
```

## firmware/src/Kconfig.projbuild
```kconfig
menu "Pendulum sensor"

config SENSOR_ESPNOW
    bool "Use ESP-NOW instead of Wi-Fi / UDP"
    default y
    help
        Send samples through an ESP-NOW USB gateway. The AP connection,
        reconnection task, IP configuration and UDP code are excluded.
        The Wi-Fi radio driver is still required by ESP-NOW.

config SENSOR_ESPNOW_CHANNEL
    int "ESP-NOW radio channel"
    depends on SENSOR_ESPNOW
    range 1 11
    default 1
    help
        Must match the gateway channel. No access point is required.

if !SENSOR_ESPNOW

config SENSOR_WIFI_SSID
    string "Wi-Fi SSID"
    default ""
    help
        Wi-Fi network used by the sensor node. Leave empty to run sampling
        without starting the network.

config SENSOR_WIFI_PASSWORD
    string "Wi-Fi password"
    default ""
    help
        WPA2 passphrase for the configured network (8-63 bytes), or a 64-digit
        hexadecimal pre-shared key. An empty password selects an open network.

config SENSOR_SERVER_IPV4
    string "UDP server IPv4 address"
    default "192.168.1.100"

config SENSOR_SERVER_PORT
    int "UDP server port"
    range 1 65535
    default 5000

endif

endmenu
```
